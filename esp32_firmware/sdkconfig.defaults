## esp32_usb_hid_test/sdkconfig.defaults
```kconfig
# ESP32-S3 Super Mini · USB HID 键盘最小测试
# 本测试完全不使用蓝牙：板子通过 USB 口直接当有线键盘
CONFIG_IDF_TARGET="esp32s3"

# 蓝牙全部关闭
CONFIG_BT_ENABLED=n

# TinyUSB HID（USB Device）
CONFIG_TINYUSB_HID_COUNT=1

# 控制台改走 UART0：USB 口要让给 HID，不能再占用 USB-Serial-JTAG
CONFIG_ESP_CONSOLE_UART_DEFAULT=y
CONFIG_ESP_CONSOLE_SECONDARY_NONE=y

# 板载 4MB Flash
CONFIG_ESPTOOLPY_FLASHSIZE_4MB=y
CONFIG_ESPTOOLPY_FLASHSIZE="4MB"
```

## terminals/sources/multi-target-6/esp32_bridge_firmware/sdkconfig.defaults
```kconfig
# ESP32-S3 Super Mini · 桥接固件：USB HID 输出 + BLE 数据通道
CONFIG_IDF_TARGET="esp32s3"

# BLE（NimBLE，仅作数据通道；不再做 BLE HID 键盘）
CONFIG_BT_ENABLED=y
CONFIG_BT_NIMBLE_ENABLED=y
CONFIG_BT_NIMBLE_ROLE_PERIPHERAL=y
CONFIG_BT_NIMBLE_MAX_CONNECTIONS=3

# USB HID 键盘输出（TinyUSB）
CONFIG_TINYUSB_HID_COUNT=1

# 控制台走 UART0：USB 口让给 HID
CONFIG_ESP_CONSOLE_UART_DEFAULT=y
CONFIG_ESP_CONSOLE_SECONDARY_NONE=y

# PSRAM 大缓冲
CONFIG_SPIRAM=y
CONFIG_SPIRAM_MODE_QUAD=y

# 4MB Flash
CONFIG_ESPTOOLPY_FLASHSIZE_4MB=y
CONFIG_ESPTOOLPY_FLASHSIZE="4MB"
```
